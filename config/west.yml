## config/west.yml
```yaml
manifest:
  remotes:
    - name: zmkfirmware
      url-base: https://github.com/zmkfirmware
    - name: m165437
      url-base: https://github.com/M165437
  projects:
    - name: zmk
      remote: zmkfirmware
      revision: 2025.06.20
      import: app/west.yml
    - name: nice-view-gem
      remote: m165437
      revision: main
  self:
    path: config
```
